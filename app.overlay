/ {
    gpio_keys {
            compatible = "gpio-keys";
            user_button: button {
                    label = "User";
                    gpios = <&gpio0 28 GPIO_ACTIVE_LOW>;
            };
    };

    aliases {
            sw0 = &user_button;
    };
};